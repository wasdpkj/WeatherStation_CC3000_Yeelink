//1,屏幕显示部分=============================   
#include "U8glib.h"                               //调用库  
U8GLIB_SSD1306_128X64 u8g(U8G_I2C_OPT_NONE);     //设置OLED型号  
//-------字体设置，大、中、小   
#define setFont_L u8g.setFont( u8g_font_9x18Br)
#define setFont_M u8g.setFont(u8g_font_7x13)
#define setFont_S u8g.setFont(u8g_font_fixed_v0r)
/*
font:
 u8g_font_7x13
 u8g_font_fixed_v0r
 u8g_font_chikitar
 u8g_font_osb21
 u8g_font_courB14r
 u8g_font_courB24n
 u8g_font_9x18Br
 */

const unsigned char bmp_tem[] U8G_PROGMEM = 
{
  0xE0,0x81,0x30,0x83,0x10,0x82,0x10,0x82,0x10,0xFA,0x10,0x82,
  0x10,0x82,0x10,0xFA,0x10,0x82,0xD0,0x82,0xD0,0xFA,0xD0,0x82,
  0xD0,0x82,0xD0,0xFA,0xD0,0x82,0xD0,0x82,0xD0,0xFA,0xD0,0x82,
  0xD0,0x82,0xD8,0x86,0xC4,0x88,0xF2,0x93,0xFB,0xB7,0xF9,0xA7,
  0xFD,0xAF,0xFD,0xAF,0xF9,0xA7,0xFA,0x97,0xF2,0x93,0xC4,0x88,
  0x18,0x86,0xF0,0x83
};

const unsigned char bmp_hum[] U8G_PROGMEM = 
{
0x00,0x00,0x01,0x00,0x00,0x01,0x00,0x80,0x03,0x08,0x80,0x03,0x18,0x80,0x07,0x1C,
0xC0,0x07,0x3C,0xC0,0x07,0x3E,0xE0,0x0F,0x3E,0xE0,0x0F,0x7A,0xF0,0x1F,0x7B,0xF8,
0x1F,0x72,0xF8,0x1F,0x3E,0xF8,0x3F,0x1C,0xFC,0x3F,0x00,0xFC,0x7F,0x00,0xFE,0x7F,
0x00,0xFE,0x7F,0x00,0xFE,0x7F,0x00,0xFF,0xFF,0x00,0xFF,0xFF,0x00,0xFF,0xFF,0x00,
0xF3,0xFF,0x00,0xF2,0x7F,0x00,0xE6,0x7F,0x00,0xC6,0x7F,0x00,0x0E,0x3F,0x00,0x3C,
0x1E,0x00,0xF8,0x1F,0x00,0xE0,0x07,0x00,0x80,0x01
};

const unsigned char bmp_net_offline[] U8G_PROGMEM = 
{
  0xC0,0x3F,0x00,0x00,0x00,0xF0,0x0F,0xFC,0xFC,0xFF,0x03,0x00,
  0x00,0xFF,0xFF,0xFC,0x0E,0x00,0x07,0x78,0x80,0x03,0xC0,0xFD,
  0xF2,0xFF,0x04,0xFE,0x81,0xFC,0x3F,0xFD,0x1B,0x80,0x0D,0xFF,
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  0x30,0xFC,0x3F,0xFC,0xE0,0x7F,0x00,0x00,0x00,0xF8,0x1F,0xFC
};

const unsigned char bmp_net_online[] U8G_PROGMEM = 
{
  0xC0,0x3F,0x00,0x00,0x00,0xF0,0x0F,0xFC,0xFC,0xFF,0x03,0x00,
  0x00,0xFF,0xFF,0xFC,0x0E,0x00,0x07,0x78,0x80,0x03,0xC0,0xFD,
  0xF2,0xFF,0x04,0xFE,0x81,0xFC,0x3F,0xFD,0x1B,0x80,0x0D,0xCF,
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  0x30,0xFC,0x3F,0xFC,0xE0,0x7F,0x00,0x00,0x00,0xF8,0x1F,0xFC
};


unsigned long osd_time=millis();
unsigned long osd_sleep=millis();

boolean lcd_switch=true;


void osd_setup(int _osd_setup,char* _osd_text)     //显示函数  
{
  u8g.firstPage();  
  do 
  {
    setFont_L;
    u8g.setPrintPos(4, 30); 
    u8g.print(_osd_text);
    u8g.drawFrame(0,48,128,14);
    if(_osd_setup)
      u8g.drawBox(0+2,48+2,map(_osd_setup,0,5,0,128-4),14-4);
  } 
  while( u8g.nextPage() );
}


void osd_main(boolean _NET_WEBSITE_sta)     //显示函数  
{    
  u8g.firstPage();   
  do  
  {
    u8g.setDefaultForegroundColor();

    u8g.drawXBMP( 1, 1, 15, 32, bmp_tem);
    u8g.drawXBMP( 70, 2, 24, 30, bmp_hum);

    setFont_M;                             //设置字体为大  
    u8g.setPrintPos(20, 16);         //设置文字开始坐标  
    u8g.print("`C ");   
    setFont_L;                             //设置字体为大  
    u8g.setPrintPos(20, 32);         //设置文字开始坐标  
    u8g.print(sensor_tem , 1);             //温度  

    setFont_M;                             //设置字体为大  
    u8g.setPrintPos(100, 16);         //设置文字开始坐标  
    u8g.print("%");   
    setFont_L;                             //设置字体为大  
    u8g.setPrintPos(100, 32);         //设置文字开始坐标  
    u8g.print(sensor_hum , 0);             //湿度  

    //-----------------------------
    u8g.drawBox(0, 37, 128, 64-37);
    u8g.setDefaultBackgroundColor();

    u8g.drawXBMP( 68, 39, 58, 24, _NET_WEBSITE_sta ? bmp_net_online : bmp_net_offline);

    setFont_M;                       //设置字体
    u8g.setPrintPos(1, 49);          //设置文字开始坐标  
    u8g.print(sensor_lux , 0);       //光照强度  
    setFont_S;                       //设置字体
    u8g.print(" Lux");   

    setFont_M;                       //设置字体
    u8g.setPrintPos(1, 63);          //设置文字开始坐标  
    u8g.print(sensor_pre,0);  //大气压强  
    setFont_S;                       //设置字体
    u8g.print(" Pa");   
  }   
  while( u8g.nextPage() );   
}





